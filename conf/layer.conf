## conf/layer.conf
```bitbake
# We have a conf and classes directory, add to BBPATH
BBPATH .= ":${LAYERDIR}"

# We have recipes-* directories, add to BBFILES
BBFILES += "${LAYERDIR}/recipes-*/*/*.bb \
            ${LAYERDIR}/recipes-*/*/*.bbappend"

BBFILE_COLLECTIONS += "meta-rockpro64-hacks"
BBFILE_PATTERN_meta-rockpro64-hacks = "^${LAYERDIR}/"
BBFILE_PRIORITY_meta-rockpro64-hacks = "10"

LAYERDEPENDS_meta-rockpro64-hacks = "core"
LAYERSERIES_COMPAT_meta-rockpro64-hacks = "warrior zeus"
```

## conf/machine/rockpro64.conf
```bitbake
#@TYPE: Machine
#@NAME: Pine RockPro64 (RK3399)

# from meta-rockchip
require conf/machine/include/rk3399.inc

KERNEL_DEVICETREE = "rockchip/rk3399-rockpro64.dtb"
# KBUILD_DEFCONFIG = "rockchip_linux_defconfig"

UBOOT_MACHINE = "rockpro64-rk3399_defconfig"
# UBOOT_MACHINE = "evb-rk3399_defconfig"

RK_BOOT_DEVICE = "mmcblk1"
WKS_FILE ?= "rockpro64.wks"
WIC_CREATE_EXTRA_ARGS ?= "--no-fstab-update"
IMAGE_FSTYPES += "wic wic.bmap"

WKS_FILE_DEPENDS ?= " \
    mtools-native \
    dosfstools-native \
    virtual/bootloader \
    virtual/kernel \
    "
IMAGE_BOOT_FILES ?= "\
    ${KERNEL_IMAGETYPE} \
    "

SERIAL_CONSOLES = "1500000;ttyS2"

MACHINE_EXTRA_RRECOMMENDS += "kernel-modules brcmfmac-sdio-firmware"
```

## wic/rk3399-boot.fixed.wks
```
# Copyright (C) 2020 Garmin Ltd. or its subsidiaries
# Released under the MIT license (see COPYING.MIT for the terms)
#
# Disk layout
# Note that the reference documentation refers to 512 byte disk sectors, but
# wic uses 1KB blocks
#
#   Partition   Start Sector    Number of Sectors
#   loader1     64              8000
#   reserved1   8064            128
#   reserved2   8192            8192
#   loader2     16384           8192
#   atf         24576           8192
#   boot        32768           229376
#   root        262144          -           (suggested)
#

part loader1    --align 32     --fixed-size 4000K            --ondisk ${RK_BOOT_DEVICE} --source rawcopy --sourceparams="file=idbloader.img"
part reserved1  --align 4032   --fixed-size 64K              --ondisk ${RK_BOOT_DEVICE}
part reserved2  --align 4096   --fixed-size 4096K            --ondisk ${RK_BOOT_DEVICE}
part loader2    --align 8192   --fixed-size 4096K            --ondisk ${RK_BOOT_DEVICE} --source rawcopy --sourceparams="file=u-boot.itb"
part atf        --align 12288  --fixed-size 4096K            --ondisk ${RK_BOOT_DEVICE}
part /boot      --align 16384  --size       114688K --active --ondisk ${RK_BOOT_DEVICE} --source bootimg-partition --fstype=vfat --label boot --sourceparams="loader=u-boot"
```

## wic/rockpro64.wks
```
# Copyright (C) 2020 Garmin Ltd. or its subsidiaries
# Released under the MIT license (see COPYING.MIT for the terms)

include rk3399-boot.fixed.wks
part / --align 131072 --ondisk ${RK_BOOT_DEVICE} --source rootfs --fstype=ext4 --label root

bootloader --ptable gpt --append="console=tty1 console=ttyS2,1500000n8 rw root=/dev/${RK_BOOT_DEVICE}p7 rootfstype=ext4 init=/sbin/init rootwait earlycon=uart8250,mmio32,0xff1a0000"
```
